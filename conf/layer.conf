## conf/layer.conf
```bitbake
# We have a conf and classes directory, add to BBPATH
BBPATH .= ":${LAYERDIR}"

# We have recipes-* directories, add to BBFILES
BBFILES += "${LAYERDIR}/recipes-*/*/*.bb \
            ${LAYERDIR}/recipes-*/*/*.bbappend"

BBFILE_COLLECTIONS += "meta-innomedia"
BBFILE_PATTERN_meta-innomedia = "^${LAYERDIR}/"
BBFILE_PRIORITY_meta-innomedia = "6"

LAYERDEPENDS_meta-innomedia = "core"
LAYERSERIES_COMPAT_meta-innomedia = "dunfell"
```
